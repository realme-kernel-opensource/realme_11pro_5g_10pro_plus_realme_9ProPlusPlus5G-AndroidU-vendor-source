## vendor/oplus/kernel/oplus_performance/healthinfo/main/Kconfig
```kconfig
#ifdef OPLUS_FEATURE_HEALTHINFO
#//wenbin.liu@PSW.Kernel.MM, 2018/05/23, Add for Healthinfo monitor
config OPLUS_HEALTHINFO
bool "config healthinfo"
help
    define this config to init  healthinfo.

config OPLUS_HEALTHINFO_CPUFREQ_MAX
bool "config cpufreq max"
help
    define this config for cpufreq max.
#endif /* OPLUS_FEATURE_HEALTHINFO */
config OPLUS_FEATURE_AUDIO_OPT
        bool "config audio opt"
        default n
        help
          audio task schedule opt
```

## vendor/oplus/kernel_4.19/audio/Kconfig
```kconfig
#
# oplus extend audio codec configuration
#

# Jun.Liang@MULTIMEDIA.AUDIODRIVER.SMARTPA, 2020/09/08, add for SIA PA ALGO
config SIA_PA_ALGO
	bool "Use SIA PA ALGO"
	default n

# Yujie.Xiang@MULTIMEDIA.AUDIODRIVER.SMARTPA, 2022/06/21, add for SIA PA
config SIA_PA_ALGO_MT6833
	bool "Use SIA PA FOR MT6833"
	default n

# Xijing.Zhou@MULTIMEDIA.AUDIODRIVER.SMARTPA, 2022/12/06, add for synchronize SIA PA register
config SIA_PA_REG_MT6769
        bool "Use for synchronize register"
        default n

config SND_SOC_AW87339
	bool "Use AW87339 As PA"
	default n

#Yongzhi.Zhang@PSW.MM.AudioDriver.Codec, 2019/09/27, add for SIA PA ALGO
config HSKEY_BLOCK
	bool "Block hskey for 1s"
	default n
#ifdef OPLUS_ARCH_EXTENDS
#Kun.Zhao@MULTIMEDIA.AUDIODRIVER.MACHINE, 2021/4/22, bring up aw87339
config SND_SOC_AW87XXX
        tristate "SoC Audio for awinic AW87XXX Smart K PA"
        depends on I2C
        help
          This option enables support for AW87XXX Smart K PA.

#Yunfan.Li@MULTIMEDIA.AUDIODRIVER.MACHINE, 2022/05/30, bring up aw87360
config SND_SOC_AW87XXX_2_X_0
        tristate "SoC Audio for awinic AW87360 Smart K PA-Only For limu"
        depends on I2C
        help
          This option enables support for AW87390 Smart K PA.
#Kun.Zhao@MULTIMEDIA.AUDIODRIVER.CODEC,2021/4/22,add PA manager
config SND_SOC_OPLUS_PA_MANAGER
       bool "add PA manager"
       default n

# Haiping.bai@MULTIMEDIA.AUDIODRIVER.CODEC, 2021/12/10, add for SIA PA
config SND_SOC_SIA81XX_V1_2_0
	bool "Use SIA PA Driver V1.2.0"
	default n

# add for SIA SmartPA sia91xxseries
config SND_SOC_SIA91XX_V3_1_0
	bool "Use SIA PA Driver V3.1.0"
	default n

# Yujie.Xiang@MULTIMEDIA.AUDIODRIVER.CODEC, 2022/05/06, add for tfa haptic
config SND_SOC_TFA_HAPTIC
	bool "add tfa haptic"
	default n

config SND_SOC_FSA
        bool "add fsa driver"
	default n

# add for Audio Type-C switch
config SND_SOC_OPLUS_TYPEC_SWITCH
	bool "add for Audio Type-C switch"
	default n
#endif /* OPLUS_ARCH_EXTENDS */
```
